; THIS SUBROUTINE WRITES CHARACTERS ON THE LCD
LCD_DATA EQU P2    ;LCD DATA PORT
LCD_RS   EQU P0.0  ;LCD REGISTER SELECT
LCD_RW   EQU P0.1  ;LCD READ/WRITE
LCD_EN   EQU P0.2  ;LCD ENABLE

ORG 0000H
LJMP START

ORG 200H
	
START:
LCD1:
      MOV P2,#00H
      MOV P1,#00H
	  ;INITIAL DELAY FOR LCD POWER UP

	;HERE1:SETB P1.0
      	  ACALL DELAY
	;CLR P1.0
	  ACALL DELAY
	;SJMP HERE1


	  ACALL LCD_INIT      ;INITIALISE LCD
	
	  ACALL DELAY
	  ACALL DELAY
	  ACALL DELAY
	  MOV A,#82H		 ;PUT CURSOR ON FIRST ROW,5 COLUMN
	  ACALL LCD_COMMAND	 ;SEND COMMAND TO LCD
	  ACALL DELAY
	  MOV   DPTR,#MY_STRING1   ;LOAD DPTR WITH SRING1 ADDR
	  ACALL LCD_SENDSTRING	   ;CALL TEXT STRINGS SENDING ROUTINE
	  ACALL DELAY

	  MOV A,#0C3H		  ;PUT CURSOR ON SECOND ROW,3 COLUMN
	  ACALL LCD_COMMAND
	  ACALL DELAY
	  MOV   DPTR,#MY_STRING2
	  ACALL LCD_SENDSTRING

JMP RESET			//STAY HERE 

;------------------------LCD INITIALISATION ROUTINE----------------------------------------------------
LCD_INIT:
         MOV   LCD_DATA,#38H  ;FUNCTION SET: 2 LINE, 8-BIT, 5X7 DOTS
         CLR   LCD_RS         ;SELECTED COMMAND REGISTER
         CLR   LCD_RW         ;WE ARE WRITING IN INSTRUCTION REGISTER
         SETB  LCD_EN         ;ENABLE H->L
		 ACALL DELAY
         CLR   LCD_EN
	     ACALL DELAY

         MOV   LCD_DATA,#0CH  ;DISPLAY ON, CURSON OFF
         CLR   LCD_RS         ;SELECTED INSTRUCTION REGISTER
         CLR   LCD_RW         ;WE ARE WRITING IN INSTRUCTION REGISTER
         SETB  LCD_EN         ;ENABLE H->L
		 ACALL DELAY
         CLR   LCD_EN
         
		 ACALL DELAY
         MOV   LCD_DATA,#01H  ;CLEAR LCD
         CLR   LCD_RS         ;SELECTED COMMAND REGISTER
         CLR   LCD_RW         ;WE ARE WRITING IN INSTRUCTION REGISTER
         SETB  LCD_EN         ;ENABLE H->L
		 ACALL DELAY
         CLR   LCD_EN
         
		 ACALL DELAY

         MOV   LCD_DATA,#06H  ;ENTRY MODE, AUTO INCREMENT WITH NO SHIFT
         CLR   LCD_RS         ;SELECTED COMMAND REGISTER
         CLR   LCD_RW         ;WE ARE WRITING IN INSTRUCTION REGISTER
         SETB  LCD_EN         ;ENABLE H->L
		 ACALL DELAY
         CLR   LCD_EN

		 ACALL DELAY
         
         RET                  ;RETURN FROM ROUTINE

;-----------------------COMMAND SENDING ROUTINE-------------------------------------
 LCD_COMMAND:
         MOV   LCD_DATA,A     ;MOVE THE COMMAND TO LCD PORT
         CLR   LCD_RS         ;SELECTED COMMAND REGISTER
         CLR   LCD_RW         ;WE ARE WRITING IN INSTRUCTION REGISTER
         SETB  LCD_EN         ;ENABLE H->L
		 ACALL DELAY
         CLR   LCD_EN
		 ACALL DELAY
    
         RET  
;-----------------------DATA SENDING ROUTINE-------------------------------------		     
 LCD_SENDDATA:
         MOV   LCD_DATA,A     ;MOVE THE COMMAND TO LCD PORT
         SETB  LCD_RS         ;SELECTED DATA REGISTER
         CLR   LCD_RW         ;WE ARE WRITING
         SETB  LCD_EN         ;ENABLE H->L
		 ACALL DELAY
         CLR   LCD_EN
         ACALL DELAY
		 ACALL DELAY
         RET                  ;RETURN FROM BUSY ROUTINE

;-----------------------TEXT STRINGS SENDING ROUTINE-------------------------------------
LCD_SENDSTRING:
	PUSH 0E0H
	LCD_SENDSTRING_LOOP:
	 	 CLR   A                 ;CLEAR ACCUMULATOR FOR ANY PREVIOUS DATA
	         MOVC  A,@A+DPTR         ;LOAD THE FIRST CHARACTER IN ACCUMULATOR
	         JZ    EXIT              ;GO TO EXIT IF ZERO
	         ACALL LCD_SENDDATA      ;SEND FIRST CHAR
	         INC   DPTR              ;INCREMENT DATA POINTER
	         SJMP  LCD_SENDSTRING_LOOP    ;JUMP BACK TO SEND THE NEXT CHARACTER
EXIT:    POP 0E0H
         RET                     ;END OF ROUTINE

;----------------------DELAY ROUTINE-----------------------------------------------------
DELAY:	 PUSH 0
	 PUSH 1
         MOV R0,#1
LOOP2:	 MOV R1,#255
	 LOOP1:	 DJNZ R1, LOOP1
	 DJNZ R0, LOOP2
	 POP 1
	 POP 0 
	 RET

;------------- ROM TEXT STRINGS---------------------------------------------------------------
ORG 300H
MY_STRING1:
         DB   "ENTER INPUTS", 00H
MY_STRING2:
		 DB   "EE337-2022", 00H
MY_STRING3:
		 DB   "READING INPUTS", 00H
MY_STRING4:
         DB   "COMPUTING RESULT", 00H
MY_STRING5:
         DB   "NUM1:",00H
		
MY_STRING6:
         DB   ", NUM2:" ,00H
MY_STRING7:
         DB   "RESULT = " ,00H
MY_STRING8:
         DB   "                " ,00H
			 
RESET : MOV P1,#0F0H
        ACALL DELAY_1S

// STATE1

MOV A,#81H		 ;PUT CURSOR ON FIRST ROW,1 COLUMN
ACALL LCD_COMMAND	 ;SEND COMMAND TO LCD
ACALL DELAY
MOV   DPTR,#MY_STRING3   ;LOAD DPTR WITH SRING1 ADDR
ACALL LCD_SENDSTRING	   ;CALL TEXT STRINGS SENDING ROUTINE
ACALL DELAY

MOV A,#0C3H		 ;PUT CURSOR ON FIRST ROW,3 COLUMN
ACALL LCD_COMMAND	 ;SEND COMMAND TO LCD
ACALL DELAY
MOV   DPTR,#MY_STRING2   ;LOAD DPTR WITH SRING1 ADDR
ACALL LCD_SENDSTRING	   ;CALL TEXT STRINGS SENDING ROUTINE
ACALL DELAY

MOV P1, #8FH
ACALL DELAY_2S
MOV A,P1
MOV B, #16
DIV AB
MOV A, B
SWAP A
MOV 40H,A

MOV P1,#4FH
ACALL DELAY_2S
MOV A,P1
MOV B, #16
DIV AB
MOV A, B
ADD A,40H
MOV 41H,A

MOV P1,#2FH
ACALL DELAY_2S
MOV A,P1
MOV B, #16
DIV AB
MOV A,B
SWAP A
MOV 42H,A

MOV P1,#1FH
ACALL DELAY_2S
MOV A,P1
MOV B, #16
DIV AB
MOV A,B
ADD A,42H
MOV 43H,A

// ASCII CONVERSION

MOV 30H , 41H
ACALL ASCII
MOV 45H, 60H
MOV 46H, 61H

MOV 30H, 43H
ACALL ASCII
MOV 47H, 60H
MOV 48H, 61H

// STATE 5
MOV P1 , #00H

MOV A, #80H		 ;PUT CURSOR ON FIRST ROW,0 COLUMN
ACALL LCD_COMMAND	 ;SEND COMMAND TO LCD
ACALL DELAY
MOV   DPTR,#MY_STRING4   ;LOAD DPTR WITH SRING4 ADDR
ACALL LCD_SENDSTRING	   ;CALL TEXT STRINGS SENDING ROUTINE
ACALL DELAY_2S

MOV A,#0C0H		 ;PUT CURSOR ON SECOND ROW,0 COLUMN
ACALL LCD_COMMAND	 ;SEND COMMAND TO LCD
ACALL DELAY
MOV   DPTR,#MY_STRING5   ;LOAD DPTR WITH SRING1 ADDR
ACALL LCD_SENDSTRING	   ;CALL TEXT STRINGS SENDING ROUTINE

MOV A, 45H
ACALL LCD_SENDDATA
MOV A, 46H
ACALL LCD_SENDDATA

MOV   DPTR,#MY_STRING6   ;LOAD DPTR WITH SRING6 ADDR
ACALL LCD_SENDSTRING	   ;CALL TEXT STRINGS SENDING ROUTINE

MOV A, 47H
ACALL LCD_SENDDATA
MOV A, 48H
ACALL LCD_SENDDATA

// DELAY TO SEE THE NUMBERS PROPERLY

ACALL DELAY_2S
ACALL DELAY_2S
ACALL DELAY_2S

// STATE 6

MOV A , 41H
MOV B , 43H
MUL AB
MOV 49H, A
MOV 50H, B

// ASCII CONVERSION

MOV 30H, 49H
ACALL ASCII
MOV 65H, 60H
MOV 66H, 61H

MOV 30H, 50H
ACALL ASCII
MOV 67H, 60H
MOV 68H, 61H

// MAKING THE SCREEN CLEAR FIRST

MOV A,#80H		 ;PUT CURSOR ON FIRST ROW,1 COLUMN
ACALL LCD_COMMAND	 ;SEND COMMAND TO LCD
ACALL DELAY
MOV   DPTR,#MY_STRING8   ;LOAD DPTR WITH SRING8 ADDR
ACALL LCD_SENDSTRING	   ;CALL TEXT STRINGS SENDING ROUTINE

MOV A,#81H		 ;PUT CURSOR ON FIRST ROW,1 COLUMN
ACALL LCD_COMMAND	 ;SEND COMMAND TO LCD
ACALL DELAY
MOV   DPTR,#MY_STRING7   ;LOAD DPTR WITH SRING7 ADDR
ACALL LCD_SENDSTRING	   ;CALL TEXT STRINGS SENDING ROUTINE

// SENDING RESULT 

MOV A, 67H
ACALL LCD_SENDDATA
MOV A, 68H
ACALL LCD_SENDDATA

MOV A, 65H
ACALL LCD_SENDDATA
MOV A, 66H
ACALL LCD_SENDDATA

HERE : SJMP HERE    

// ASCII CONVERSION FROM PREVIOUS

ASCII: MOV A,30H         
       MOV B,#16
       DIV AB                // SEPARATING THE FIRST 4 AND LAST 4 BITS OF THE 8 BIT NUMBER
       CJNE A, #0AH, FUNC1
	   
	   ACALL MORE
	   MOV 60H,A
	   MOV A,B
	   JMP FUNC2     // FOR THE LAST 4 BITS
	  
	    
FUNC1: ACALL CHECK
       MOV 60H,A
       MOV A,B
	   CJNE A, #0AH, FUNC2  // FOR THE LAST 4 BITS
	   JMP MORE
	
FUNC2: ACALL CHECK
	   MOV 61H,A
	   RET
	   
MORE:  ADD A,#37H          // IF THE NUMBER IS GREATER THAN A ADDING WITH 37H BECAUSE OF THE 7 SYMBOLS IN BETWEEN
       RET
	   
LESS:  ADD A,#30H          // IF THE NUMBER IS LESSER THAN A ADD WITH 30H
       RET
	   
CHECK: JC  LESS
       JNC MORE

DELAY_6S:      // 6 S DELAY
PUSH 00H
MOV R0, #3
H6: ACALL DELAY_2S
DJNZ R0, H6
POP 00H
RET

DELAY_2S:      // 2 S DELAY
PUSH 00H
MOV R0, #2
H5: ACALL DELAY_1S
DJNZ R0, H5
POP 00H
RET

DELAY_1S:    // 1 S DELAY
PUSH 00H
MOV R0, #5
H4: ACALL DELAY_200MS
DJNZ R0, H4
POP 00H
RET

DELAY_200MS:  // 200MS DELAY
PUSH 00H
MOV R0, #200
H3: ACALL DELAY_1MS
DJNZ R0, H3
POP 00H
RET

DELAY_1MS:  // 1MS DELAY
PUSH 00H
MOV R0, #4
H2: ACALL DELAY_250US
DJNZ R0, H2
POP 00H
RET

DELAY_250US:    // 250US DELAY
PUSH 00H
MOV R0, #244
H1: DJNZ R0, H1
POP 00H
RET

END
