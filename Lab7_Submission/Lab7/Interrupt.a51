; THIS SUBROUTINE WRITES CHARACTERS ON THE LCD
LCD_DATA EQU P2    ;LCD DATA PORT
LCD_RS   EQU P0.0  ;LCD REGISTER SELECT
LCD_RW   EQU P0.1  ;LCD READ/WRITE
LCD_EN   EQU P0.2  ;LCD ENABLE
SW1		 EQU P1.0  ;Switch
	
ORG 0000H
LJMP START

org 000BH
LJMP INTERRUPT_T0

org 0030H
INTERRUPT_T0:  MOV TH0, #00H     		
			   MOV TL0, #00H
			   SETB TR0                
		       SETB ET0                
		       INC R4		//COUNTING OVERFLOW
		       RETI
			   
ORG 200H
	
START:
LCD1:
      MOV P2,#00H
      MOV P1,#0FH
	  ;INITIAL DELAY FOR LCD POWER UP

	;HERE1:SETB P1.0
      	  ACALL DELAY
	;CLR P1.0
	  ACALL DELAY
	;SJMP HERE1


	  ACALL LCD_INIT      ;INITIALISE LCD
	
	  ACALL DELAY
	  ACALL DELAY
	  ACALL DELAY

JMP STEP1


;------------------------LCD INITIALISATION ROUTINE----------------------------------------------------
LCD_INIT:
         MOV   LCD_DATA,#38H  ;FUNCTION SET: 2 LINE, 8-BIT, 5X7 DOTS
         CLR   LCD_RS         ;SELECTED COMMAND REGISTER
         CLR   LCD_RW         ;WE ARE WRITING IN INSTRUCTION REGISTER
         SETB  LCD_EN         ;ENABLE H->L
		 ACALL DELAY
         CLR   LCD_EN
	     ACALL DELAY

         MOV   LCD_DATA,#0CH  ;DISPLAY ON, CURSON OFF
         CLR   LCD_RS         ;SELECTED INSTRUCTION REGISTER
         CLR   LCD_RW         ;WE ARE WRITING IN INSTRUCTION REGISTER
         SETB  LCD_EN         ;ENABLE H->L
		 ACALL DELAY
         CLR   LCD_EN
         
		 ACALL DELAY
         MOV   LCD_DATA,#01H  ;CLEAR LCD
         CLR   LCD_RS         ;SELECTED COMMAND REGISTER
         CLR   LCD_RW         ;WE ARE WRITING IN INSTRUCTION REGISTER
         SETB  LCD_EN         ;ENABLE H->L
		 ACALL DELAY
         CLR   LCD_EN
         
		 ACALL DELAY

         MOV   LCD_DATA,#06H  ;ENTRY MODE, AUTO INCREMENT WITH NO SHIFT
         CLR   LCD_RS         ;SELECTED COMMAND REGISTER
         CLR   LCD_RW         ;WE ARE WRITING IN INSTRUCTION REGISTER
         SETB  LCD_EN         ;ENABLE H->L
		 ACALL DELAY
         CLR   LCD_EN

		 ACALL DELAY
         
         RET                  ;RETURN FROM ROUTINE

;-----------------------COMMAND SENDING ROUTINE-------------------------------------
 LCD_COMMAND:
         MOV   LCD_DATA,A     ;MOVE THE COMMAND TO LCD PORT
         CLR   LCD_RS         ;SELECTED COMMAND REGISTER
         CLR   LCD_RW         ;WE ARE WRITING IN INSTRUCTION REGISTER
         SETB  LCD_EN         ;ENABLE H->L
		 ACALL DELAY
         CLR   LCD_EN
		 ACALL DELAY
    
         RET  
;-----------------------DATA SENDING ROUTINE-------------------------------------		     
 LCD_SENDDATA:
         MOV   LCD_DATA,A     ;MOVE THE COMMAND TO LCD PORT
         SETB  LCD_RS         ;SELECTED DATA REGISTER
         CLR   LCD_RW         ;WE ARE WRITING
         SETB  LCD_EN         ;ENABLE H->L
		 ACALL DELAY
         CLR   LCD_EN
         ACALL DELAY
		 ACALL DELAY
         RET                  ;RETURN FROM BUSY ROUTINE

;-----------------------TEXT STRINGS SENDING ROUTINE-------------------------------------
LCD_SENDSTRING:
	PUSH 0E0H
	LCD_SENDSTRING_LOOP:
	 	 CLR   A                 ;CLEAR ACCUMULATOR FOR ANY PREVIOUS DATA
	         MOVC  A,@A+DPTR         ;LOAD THE FIRST CHARACTER IN ACCUMULATOR
	         JZ    EXIT              ;GO TO EXIT IF ZERO
	         ACALL LCD_SENDDATA      ;SEND FIRST CHAR
	         INC   DPTR              ;INCREMENT DATA POINTER
	         SJMP  LCD_SENDSTRING_LOOP    ;JUMP BACK TO SEND THE NEXT CHARACTER
EXIT:    POP 0E0H
         RET                     ;END OF ROUTINE

;----------------------DELAY ROUTINE-----------------------------------------------------
DELAY:	 PUSH 0
	 PUSH 1
         MOV R0,#1
LOOP2:	 MOV R1,#255
	 LOOP1:	 DJNZ R1, LOOP1
	 DJNZ R0, LOOP2
	 POP 1
	 POP 0 
	 RET

;------------- ROM TEXT STRINGS---------------------------------------------------------------
ORG 300H
MY_STRING1:
         DB   "TOGGLE SW1", 00H
MY_STRING2:
         DB   "IF LED GLOWS", 00H
MY_STRING3:
         DB   "REACTION TIME", 00H
MY_STRING4:
         DB   "COUNT IS ", 00H	 
MY_STRING5:
		 DB   "MILLISECONDS: ", 00H
MY_STRING6:
		 DB   "                ", 00H
// STEP1



STEP1:  MOV A,#83H		 ;PUT CURSOR ON FIRST ROW,6 COLUMN
		ACALL LCD_COMMAND	 ;SEND COMMAND TO LCD
		ACALL DELAY
		MOV   DPTR,#MY_STRING1   ;LOAD DPTR WITH SRING1 ADDR
		ACALL LCD_SENDSTRING	   ;CALL TEXT STRINGS SENDING ROUTINE
		ACALL DELAY

		MOV A,#0C2H		 ;PUT CURSOR ON FIRST ROW,3 COLUMN
		ACALL LCD_COMMAND	 ;SEND COMMAND TO LCD
		ACALL DELAY
		MOV   DPTR,#MY_STRING2   ;LOAD DPTR WITH SRING5 ADDR
		ACALL LCD_SENDSTRING	   ;CALL TEXT STRINGS SENDING ROUTINE
		ACALL DELAY
		
		LCALL MAIN
		LCALL MAIN
		SETB ET0
		SETB EA
		SETB P1.4

// STEP2

STEP2:  MOV R4, #00
        MOV TMOD , #01
        MOV TH0 , #00H
		MOV TL0 , #00H
		SETB TR0
	
HERE: JNB SW1 , HERE

// STEP3

STEP3:  CLR TR0
        CLR P1.4
		MOV 40H, R4
		MOV 41H, TH0
		MOV 42H, TL0
		CLR TF0
		
// STEP4

STEP4:  MOV A,#80H		 ;PUT CURSOR ON FIRST ROW,6 COLUMN
		ACALL LCD_COMMAND	 ;SEND COMMAND TO LCD
		ACALL DELAY
		MOV   DPTR,#MY_STRING6   ;LOAD DPTR WITH SRING1 ADDR
		ACALL LCD_SENDSTRING	   ;CALL TEXT STRINGS SENDING ROUTINE
		ACALL DELAY

		MOV A,#0C0H		 ;PUT CURSOR ON FIRST ROW,3 COLUMN
		ACALL LCD_COMMAND	 ;SEND COMMAND TO LCD
		ACALL DELAY
		MOV   DPTR,#MY_STRING6   ;LOAD DPTR WITH SRING5 ADDR
		ACALL LCD_SENDSTRING	   ;CALL TEXT STRINGS SENDING ROUTINE
		ACALL DELAY
		
		MOV A,#82H		 ;PUT CURSOR ON FIRST ROW,6 COLUMN
		ACALL LCD_COMMAND	 ;SEND COMMAND TO LCD
		ACALL DELAY
		MOV   DPTR,#MY_STRING3   ;LOAD DPTR WITH SRING1 ADDR
		ACALL LCD_SENDSTRING	   ;CALL TEXT STRINGS SENDING ROUTINE
		ACALL DELAY

		MOV A,#0C1H		 ;PUT CURSOR ON FIRST ROW,3 COLUMN
		ACALL LCD_COMMAND	 ;SEND COMMAND TO LCD
		ACALL DELAY
		MOV   DPTR,#MY_STRING4   ;LOAD DPTR WITH SRING5 ADDR
		ACALL LCD_SENDSTRING	   ;CALL TEXT STRINGS SENDING ROUTINE
		ACALL DELAY
		
		MOV 30H, R4
		ACALL ASCII
		MOV A, 60H
		ACALL LCD_SENDDATA
		MOV A, 61H
		ACALL LCD_SENDDATA
		
		MOV 30H, TH0
		ACALL ASCII
		MOV A, 60H
		ACALL LCD_SENDDATA
		MOV A, 61H
		ACALL LCD_SENDDATA
		
		MOV 30H, TL0
		ACALL ASCII
		MOV A, 60H
		ACALL LCD_SENDDATA
		MOV A, 61H
		ACALL LCD_SENDDATA
		
		CLR ET0
		LCALL MAIN
		LCALL MAIN
		LCALL MAIN
		LCALL MAIN
		LCALL MAIN
		
		MOV A,#80H		 ;PUT CURSOR ON FIRST ROW,6 COLUMN
		ACALL LCD_COMMAND	 ;SEND COMMAND TO LCD
		ACALL DELAY
		MOV   DPTR,#MY_STRING6   ;LOAD DPTR WITH SRING1 ADDR
		ACALL LCD_SENDSTRING	   ;CALL TEXT STRINGS SENDING ROUTINE
		ACALL DELAY

		MOV A,#0C0H		 ;PUT CURSOR ON FIRST ROW,3 COLUMN
		ACALL LCD_COMMAND	 ;SEND COMMAND TO LCD
		ACALL DELAY
		MOV   DPTR,#MY_STRING6   ;LOAD DPTR WITH SRING5 ADDR
		ACALL LCD_SENDSTRING	   ;CALL TEXT STRINGS SENDING ROUTINE
		ACALL DELAY
		
LJMP STEP1
		
ASCII: MOV A,30H         
       MOV B,#16
       DIV AB                // SEPARATING THE FIRST 4 AND LAST 4 BITS OF THE 8 BIT NUMBER
       CJNE A, #0AH, FUNC1
	   
	   ACALL MORE   // NUMBER HAS ALREADY CROSSED THE SYMBOLS SO WE HAVE TO ADD THAT   
	   MOV 60H,A
	   MOV A,B
	   SJMP FUNC2	  // FOR THE LAST 4 BITS

FUNC2: ACALL CHECK
	   MOV 61H,A
	   RET
	   
FUNC1: ACALL CHECK
       MOV 60H,A
       MOV A,B
	   CJNE A, #0AH, FUNC2   // FOR THE LAST 4 BITS
	   SJMP MORE
	   
MORE:  ADD A,#37H          // IF THE NUMBER IS GREATER THAN A ADDING WITH 37H BECAUSE OF THE 7 SYMBOLS IN BETWEEN
       RET
	   
LESS:  ADD A,#30H          // IF THE NUMBER IS LESSER THAN A ADD WITH 30H
       RET
	   
CHECK: JC  LESS
       JNC MORE

MAIN: MOV TMOD , #01
	  MOV R3, #40 
	  ACALL LOOP3
	  RET

LOOP3: ACALL DELAY_LOOP
       RET
	   
DELAY_LOOP: ACALL DELAY_TIMER
            DJNZ R3, DELAY_LOOP
			MOV R3, #40
	        RET
	   
DELAY_TIMER: MOV TH0, #3CH
	         MOV TL0, #0B0H
	         SETB TR0

COUNT: JNB TF0, COUNT
	   CLR TR0
	   CLR TF0
	   RET

END