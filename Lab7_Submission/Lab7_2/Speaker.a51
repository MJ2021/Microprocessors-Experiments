; THIS SUBROUTINE WRITES CHARACTERS ON THE LCD
LCD_DATA EQU P2    ;LCD DATA PORT
LCD_RS   EQU P0.0  ;LCD REGISTER SELECT
LCD_RW   EQU P0.1  ;LCD READ/WRITE
LCD_EN   EQU P0.2  ;LCD ENABLE
SW1		 EQU P1.0  ;Switch
	
ORG 0000H
LJMP START

ORG 200H
	
START:
LCD1:
      MOV P2,#00H
      MOV P1,#0FH
	  ;INITIAL DELAY FOR LCD POWER UP

	;HERE1:SETB P1.0
      	  ACALL DELAY
	;CLR P1.0
	  ACALL DELAY
	;SJMP HERE1


	  ACALL LCD_INIT      ;INITIALISE LCD
	
	  ACALL DELAY
	  ACALL DELAY
	  ACALL DELAY
	  
	  MOV A,#82H		 ;PUT CURSOR ON FIRST ROW,6 COLUMN
	  ACALL LCD_COMMAND	 ;SEND COMMAND TO LCD
      ACALL DELAY
	  MOV   DPTR,#MY_STRING1   ;LOAD DPTR WITH SRING4 ADDR
	  ACALL LCD_SENDSTRING	   ;CALL TEXT STRINGS SENDING ROUTINE
	  ACALL DELAY


JMP ORDER1

;------------------------LCD INITIALISATION ROUTINE----------------------------------------------------
LCD_INIT:
         MOV   LCD_DATA,#38H  ;FUNCTION SET: 2 LINE, 8-BIT, 5X7 DOTS
         CLR   LCD_RS         ;SELECTED COMMAND REGISTER
         CLR   LCD_RW         ;WE ARE WRITING IN INSTRUCTION REGISTER
         SETB  LCD_EN         ;ENABLE H->L
		 ACALL DELAY
         CLR   LCD_EN
	     ACALL DELAY

         MOV   LCD_DATA,#0CH  ;DISPLAY ON, CURSON OFF
         CLR   LCD_RS         ;SELECTED INSTRUCTION REGISTER
         CLR   LCD_RW         ;WE ARE WRITING IN INSTRUCTION REGISTER
         SETB  LCD_EN         ;ENABLE H->L
		 ACALL DELAY
         CLR   LCD_EN
         
		 ACALL DELAY
         MOV   LCD_DATA,#01H  ;CLEAR LCD
         CLR   LCD_RS         ;SELECTED COMMAND REGISTER
         CLR   LCD_RW         ;WE ARE WRITING IN INSTRUCTION REGISTER
         SETB  LCD_EN         ;ENABLE H->L
		 ACALL DELAY
         CLR   LCD_EN
         
		 ACALL DELAY

         MOV   LCD_DATA,#06H  ;ENTRY MODE, AUTO INCREMENT WITH NO SHIFT
         CLR   LCD_RS         ;SELECTED COMMAND REGISTER
         CLR   LCD_RW         ;WE ARE WRITING IN INSTRUCTION REGISTER
         SETB  LCD_EN         ;ENABLE H->L
		 ACALL DELAY
         CLR   LCD_EN

		 ACALL DELAY
         
         RET                  ;RETURN FROM ROUTINE

;-----------------------COMMAND SENDING ROUTINE-------------------------------------
 LCD_COMMAND:
         MOV   LCD_DATA,A     ;MOVE THE COMMAND TO LCD PORT
         CLR   LCD_RS         ;SELECTED COMMAND REGISTER
         CLR   LCD_RW         ;WE ARE WRITING IN INSTRUCTION REGISTER
         SETB  LCD_EN         ;ENABLE H->L
		 ACALL DELAY
         CLR   LCD_EN
		 ACALL DELAY
    
         RET  
;-----------------------DATA SENDING ROUTINE-------------------------------------		     
 LCD_SENDDATA:
         MOV   LCD_DATA,A     ;MOVE THE COMMAND TO LCD PORT
         SETB  LCD_RS         ;SELECTED DATA REGISTER
         CLR   LCD_RW         ;WE ARE WRITING
         SETB  LCD_EN         ;ENABLE H->L
		 ACALL DELAY
         CLR   LCD_EN
         ACALL DELAY
		 ACALL DELAY
         RET                  ;RETURN FROM BUSY ROUTINE

;-----------------------TEXT STRINGS SENDING ROUTINE-------------------------------------
LCD_SENDSTRING:
	PUSH 0E0H
	LCD_SENDSTRING_LOOP:
	 	 CLR   A                 ;CLEAR ACCUMULATOR FOR ANY PREVIOUS DATA
	         MOVC  A,@A+DPTR         ;LOAD THE FIRST CHARACTER IN ACCUMULATOR
	         JZ    EXIT              ;GO TO EXIT IF ZERO
	         ACALL LCD_SENDDATA      ;SEND FIRST CHAR
	         INC   DPTR              ;INCREMENT DATA POINTER
	         SJMP  LCD_SENDSTRING_LOOP    ;JUMP BACK TO SEND THE NEXT CHARACTER
EXIT:    POP 0E0H
         RET                     ;END OF ROUTINE

;----------------------DELAY ROUTINE-----------------------------------------------------
DELAY:	 PUSH 0
	 PUSH 1
         MOV R0,#1
LOOP2:	 MOV R1,#255
	 LOOP1:	 DJNZ R1, LOOP1
	 DJNZ R0, LOOP2
	 POP 1
	 POP 0 
	 RET

;------------- ROM TEXT STRINGS---------------------------------------------------------------
ORG 300H
MY_STRING1:
         DB   "ROLLING TIME", 00H

ORG 000BH
CPL P0.7
LCALL TO_DECIDE_NOTE
RETI

TO_DECIDE_NOTE: CJNE R0, #1, NOT1
			    LCALL NOTE1
			    RET
			   
NOT1: CJNE R0, #2, NOT2
	  LCALL NOTE2
	  RET
	  
NOT2: CJNE R0, #3, NOT3
	  LCALL NOTE3
	  RET
	  
NOT3: CJNE R0, #4, NOT4
	  LCALL NOTE4
	  RET

NOT4: CJNE R0, #5, NOT5
	  LCALL NOTE5
	  RET
	  
NOT5: CLR P0.7
	  RET
	  
ORG 0500H
// ORDER1

ORDER1: MOV TMOD, #11H
		MOV R4, #3
		MOV R0, #1
		LCALL NOTE1
		SETB ET0
		SETB EA
		SETB TR0
		LCALL TIMER1_DELAY

// ORDER2

ORDER2: MOV R4, #3
		LCALL NOTE2
		SETB ET0
		SETB EA
		SETB TR0
		MOV R0, #2
		LCALL TIMER1_DELAY
		
// ORDER3

ORDER3: MOV R4, #3
		LCALL NOTE3
		SETB ET0
		SETB EA
		SETB TR0
		MOV R0, #3
		LCALL TIMER1_DELAY
		
// ORDER4

ORDER4: MOV R4, #3
		LCALL NOTE2
		SETB ET0
		SETB EA
		SETB TR0
		MOV R0, #2
		LCALL TIMER1_DELAY
		
// ORDER5

ORDER5: MOV R4, #4
		LCALL NOTE4
		SETB ET0
		SETB EA
		SETB TR0
		MOV R0, #4
		LCALL TIMER1_DELAY
		
// ORDER6

SILENCE: MOV R4, #2
		 MOV R0, #0
		 LCALL TIMER1_DELAY
		 
// ORDER7

ORDER7: MOV R4, #4
		LCALL NOTE4
		SETB ET0
		SETB EA
		SETB TR0
		MOV R0, #4
		LCALL TIMER1_DELAY
		
// ORDER8

ORDER8: MOV R4, #4
		LCALL NOTE5
		SETB ET0
		SETB EA
		SETB TR0
		MOV R0 , #5
		LCALL TIMER1_DELAY

LJMP ORDER1            // REPEATING SAME ORDER
// NOTE1

NOTE1: MOV TL0, #7DH       // FREQUENCY 220 HZ
	   MOV TH0, #0DCH
	   RET
	   
// NOTE2

NOTE2: MOV TL0, #5EH    // FREQUENCY 247HZ
	   MOV TH0, #0E0H
	   RET

// NOTE3

NOTE3: MOV TL0, #6DH       // FREQUENCY 294HZ
	   MOV TH0, #0E5H
	   RET
	   
// NOTE4

NOTE4: MOV TL0, #0E2H      // FREQUENCY 370HZ
	   MOV TH0, #0EAH
	   RET
	   
// NOTE5

NOTE5: MOV TL0, #53H
	   MOV TH0, #0E8H      // FREQUENCY 330 HZ
	   RET
	   
TIMER1_DELAY: MOV B, #10 
			  MOV A, R4          // R4 HAS THE VALUE 2,3,4 FOR 500, 750 AND 1000MS RESPECTIVELY
			  MUL AB
			  MOV R3, A

			  ACALL LOOP3
			  RET

LOOP3: ACALL DELAY_LOOP
       RET
	   
DELAY_LOOP: ACALL DELAY_TIMER
            DJNZ R3, DELAY_LOOP
	        RET
	   
DELAY_TIMER: MOV TH1, #3CH
	         MOV TL1, #0B0H
	         SETB TR1

COUNT: JNB TF1, COUNT
	   CLR TR1
	   CLR TF1
	   RET
	   
END